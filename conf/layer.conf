## conf/layer.conf
```bitbake
# We have a conf and classes directory, add to BBPATH
BBPATH .= ":${LAYERDIR}"

# We have recipes-* directories, add to BBFILES
BBFILES += "${LAYERDIR}/recipes-*/*/*.bb \
            ${LAYERDIR}/recipes-*/*/*.bbappend"

BBFILE_COLLECTIONS += "meta-template-yoep"
BBFILE_PATTERN_meta-template-yoep = "^${LAYERDIR}/"
BBFILE_PRIORITY_meta-template-yoep = "6"

LAYERDEPENDS_meta-template-yoep = "core"
LAYERSERIES_COMPAT_meta-template-yoep = "honister"
```
